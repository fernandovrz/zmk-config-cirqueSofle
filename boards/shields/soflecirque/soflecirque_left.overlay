/*
 * Copyright (c) 2020 Ryan Cross
 *
 * SPDX-License-Identifier: MIT
 */

#include "soflecirque.dtsi"

&kscan0 {
    col-gpios
        = <&pro_micro 19 GPIO_ACTIVE_HIGH>
        , <&pro_micro 18 GPIO_ACTIVE_HIGH>
        , <&pro_micro 15 GPIO_ACTIVE_HIGH>
        , <&pro_micro 14 GPIO_ACTIVE_HIGH>
        , <&pro_micro 16 GPIO_ACTIVE_HIGH>
        , <&pro_micro 10 GPIO_ACTIVE_HIGH>
        ;
};

&left_encoder {
    status = "okay";
};

// Esta mitad NO lleva trackpad: del bus I2C solo cuelga el OLED (0x3c).
//
// Aqui habia un nodo cirque,pinnacle en 0x2a apuntando a un dispositivo
// inexistente, con su pin de data-ready flotando sin resistencia. Las
// interrupciones espurias de ese pin disparaban lecturas I2C continuas a
// un chip que nunca responde, saturando el bus y dejando la pantalla
// encendida pero sin poder escribirse (ruido de encendido en el panel).
&pro_micro_i2c {
    status = "okay";
};

// Sin trackpad local no hay nada que reenviar a la central. El nodo debe
// quedar deshabilitado, no vacio: en un periferico zmk,input-split lleva un
// BUILD_ASSERT que exige la propiedad `device`.
&glidepoint_split {
    status = "disabled";
};
